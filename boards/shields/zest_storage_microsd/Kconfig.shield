## boards/shields/zest_storage_microsd/Kconfig.shield
```kconfig
# Copyright (c) 2024 CATIE
# SPDX-License-Identifier: Apache-2.0

config SHIELD_ZEST_STORAGE_MICROSD
	def_bool $(shields_list_contains,zest_storage_microsd)
```
